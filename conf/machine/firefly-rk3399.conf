## conf/machine/firefly-rk3399.conf
```bitbake
# Copyright (C) 2017 Fuzhou Rockchip Electronics Co., Ltd
# Released under the MIT license (see COPYING.MIT for the terms)

#@TYPE: Machine
#@NAME: Firefly RK3399
#@DESCRIPTION: Firefly-RK3399 is a Six-Core 64-bit High-Performance Platform.
#http://www.t-firefly.com/en/

include conf/machine/include/rk3399.inc

KERNEL_DEVICETREE = "rockchip/rk3399-firefly-linux.dtb"
UBOOT_MACHINE = "evb-rk3399_defconfig"

GPTIMG_APPEND = "console=tty1 console=ttyFIQ0,1500000n8 rw root=/dev/mmcblk1p7 rootfstype=ext4 init=/sbin/init"
```

## conf/machine/include/rk-linux.inc
```bitbake
# Rockchip BSP default settings

PREFERRED_PROVIDER_virtual/egl = "mali-userspace"
PREFERRED_PROVIDER_virtual/libgles1 = "mali-userspace"
PREFERRED_PROVIDER_virtual/libgles2 = "mali-userspace"
PREFERRED_PROVIDER_virtual/libopencl = "mali-userspace"

# Workaround: libmali.so provided by rk having no SONAME field in it
# so add it to fix rdepends problems
ASSUME_SHLIBS += "libEGL.so:mali-userspace"
ASSUME_SHLIBS += "libGLESv1_CM.so:mali-userspace"
ASSUME_SHLIBS += "libGLESv2.so:mali-userspace"
ASSUME_SHLIBS += "libOpenCL.so:mali-userspace"
ASSUME_SHLIBS += "libgbm.so:mali-userspace"
ASSUME_SHLIBS += "libwayland-egl.so:mali-userspace"

PREFERRED_PROVIDER_virtual/kernel = "linux-rockchip"
PREFERRED_PROVIDER_virtual/bootloader = "u-boot-rockchip"

IMAGE_CLASSES += "rockchip-next-image"
```

## conf/machine/include/rk3288.inc
```bitbake
# Copyright (C) 2015 Romain Perier
# Released under the MIT license (see COPYING.MIT for the terms)

SOC_FAMILY = "rk3288"

require conf/machine/include/tune-cortexa17.inc
require conf/machine/include/soc-family.inc

PREFERRED_PROVIDER_virtual/kernel ?= "linux"
SERIAL_CONSOLES = "115200;ttyS2"
SPL_BINARY = "u-boot-spl-dtb.bin"
KERNEL_IMAGETYPE = "zImage"
KBUILD_DEFCONFIG = "multi_v7_defconfig"

PREFERRED_PROVIDER_virtual/bootloader ?= "u-boot-rockchip"
SPL_BINARY ?= "u-boot-spl-dtb.bin"

IMAGE_FSTYPES = "ext4 rockchip-gpt-img"
IMAGE_CLASSES += "rockchip-gpt-img"

APPEND = "console=tty1 console=ttyS2,115200n8 rw root=/dev/mmcblk2p7 rootfstype=ext4 init=/sbin/init"
PREFERRED_VERSION_mali-userspace = "t76x"
```

## conf/machine/include/tune-cortexa53.inc
```bitbake
DEFAULTTUNE ?= "cortexa53-32"

require conf/machine/include/arm/arch-armv8.inc

TUNEVALID[cortexa53] = "Enable Cortex-A53 specific processor optimizations"
TUNE_CCARGS .= "${@bb.utils.contains('TUNE_FEATURES', 'cortexa53', ' -mcpu=cortex-a53 ', '',d)}"

TUNEVALID[armv8] = "Enable instructions for ARMv8"
TUNECONFLICTS[armv8] = "armv4 armv5 armv6 armv7 armv7a armv7ve"

TUNE_CCARGS .= \
"-mtune=cortex-a57.cortex-a53"

TUNE_CCARGS_MFPU .= \
"${@' crypto-neon-fp-armv8' if bb.utils.contains('TUNE_FEATURES', [ 'armv8', 'neon', 'cryptov8' ], True, False, d) else \
' neon-fp-armv8' if bb.utils.contains('TUNE_FEATURES', [ 'armv8', 'neon' ], True, False, d) else \
bb.utils.contains('TUNE_FEATURES', [ 'armv8' ], ' fp-armv8', '', d)}"

MACHINEOVERRIDES =. "${@bb.utils.contains('TUNE_FEATURES', 'armv8', 'armv8:', '' ,d)}"

AVAILTUNES += "armv8"
TUNE_FEATURES_tune-armv8 = "armv8"
PACKAGE_EXTRA_ARCHS_tune-armv8 = "armv8"

AVAILTUNES += "armv8-neon"
TUNE_FEATURES_tune-armv8-neon = "${TUNE_FEATURES_tune-armv8} neon"
PACKAGE_EXTRA_ARCHS_tune-armv8-neon = "${PACKAGE_EXTRA_ARCHS_tune-armv8} armv8-neon"

AVAILTUNES += "armv8hf"
TUNE_FEATURES_tune-armv8hf = "${TUNE_FEATURES_tune-armv8} callconvention-hard"
PACKAGE_EXTRA_ARCHS_tune-armv8hf = "armv8hf"

AVAILTUNES += "armv8hf-neon"
TUNE_FEATURES_tune-armv8hf-neon = "${TUNE_FEATURES_tune-armv8hf} neon"
PACKAGE_EXTRA_ARCHS_tune-armv8hf-neon = "${PACKAGE_EXTRA_ARCHS_tune-armv8hf} armv8hf-neon"

# Extra tune selections
AVAILTUNES += "cortexa53-32"
ARMPKGARCH_tune-cortexa53-32 ?= "cortexa53"
TUNE_FEATURES_tune-cortexa53-32 = "${TUNE_FEATURES_tune-armv8-neon} cortexa53"
BASE_LIB_tune-cortexa53-32 = "lib"
TUNE_PKGARCH_tune-cortexa53-32 = "cortexa53-32"
PACKAGE_EXTRA_ARCHS_tune-cortexa53-32 = "${PACKAGE_EXTRA_ARCHS_tune-armv8-neon} cortexa53-32 cortexa53-neon-fp-armv8"

AVAILTUNES += "cortexa53hf-32"
ARMPKGARCH_tune-cortexa53hf-32 ?= "cortexa53"
TUNE_FEATURES_tune-cortexa53hf-32 = "${TUNE_FEATURES_tune-armv8hf-neon} cortexa53"
BASE_LIB_tune-cortexa53hf-32 = "lib"
TUNE_PKGARCH_tune-cortexa53hf-32 = "cortexa53hf-32"
PACKAGE_EXTRA_ARCHS_tune-cortexa53hf-32 = "${PACKAGE_EXTRA_ARCHS_tune-armv8hf-neon} cortexa53hf-32 cortexa53hf-neon-fp-armv8"

AVAILTUNES += "cortexa53-64"
ARMPKGARCH_tune-cortexa53-64 ?= "cortexa53"
TUNE_FEATURES_tune-cortexa53-64 = "${TUNE_FEATURES_tune-aarch64} cortexa53"
BASE_LIB_tune-cortexa53-64 = "lib64"
TUNE_PKGARCH_tune-cortexa53-64 = "cortexa53-64"
PACKAGE_EXTRA_ARCHS_tune-cortexa53-64 = "${PACKAGE_EXTRA_ARCHS_tune-aarch64} cortexa53-64"
```
